#include "oil_cs1231.h"
#include <stdint.h>
/*	FreeRTOS	*/
#include "cmsis_os.h"
#include "freertos.h"
#include "queue.h"
/*
*********************************************************************************************************
* CS1231/CS1232 的通讯程序
* 此程序使用中断的方式来判断 CS1231/CS1232  的转换数据是否准备好
* 建议使用中断方式（下降沿触发）。
* 
* 
* 关于CS1231在本程序中的设置：
* GAIN引脚--增益选择: 				GAIN=0, PGA=64(本程序); GAIN=1, PGA=128
* SPEED引脚--采样（输出）速率选择: 	SPEED=0,10Hz(本程序); SPEED=1,80Hz
* 数据输出：						24位2进制补码，MSB最先输出，1LSB = 0.5Vref/(Gain*(2^23-1))
* 			正值满幅输出: 7FFFFFH	即： 8388607
*			负值满幅输出: 800000H	即:	-8388608
*********************************************************************************************************
*/


uint32_t R_AD = 0;
static CS1231_State cs1231_state = No_Initialized;

/*
*********************************************************************************************************
* 设 计 者：王远，常州赛乐医疗技术有限公司
* 版	  本：V1.0
* 日    期：2021-08-27
* 函 数 名: void delay_n_200ns(uint8_t n200ns)
* 功能说明: 延时单位为200ns
* 形    参: 
			n200ns： 表示延迟n * 200ns
* 返 回 值: 
*********************************************************************************************************
*/
static void delay_n_200ns(uint8_t n200ns)
{
	for(uint8_t i=0; i < n200ns; i++)
		for(uint8_t j=0; j <17; j++)
			__NOP();
}
	
/*
*********************************************************************************************************
* 设 计 者：王远，常州赛乐医疗技术有限公司
* 版	  本：V1.0
* 日    期：2021-08-27
* 函 数 名: void Init_ADC_IC(void)
* 功能说明: CS1231/CS1232 初始化
* 形    参: 
      
* 返 回 值: 
*********************************************************************************************************
*/
void Init_ADC_IC(void)
{
	IO_ADC_SCLK_RST;  			//	SCLK 长时间表为低电平时，AD 会退出待机模式开始新的数据转换
	cs1231_state = Initialized;
}

void Standby_ADC_IC(void)
{
	IO_ADC_SCLK_SET;			//	SCLK 长时间表为高电平时，AD 会进入待机模式
	cs1231_state = No_Initialized;
}

/*
*********************************************************************************************************
* 设 计 者：王远，常州赛乐医疗技术有限公司
* 版	  本：V1.0
* 日    期：2021-08-27
* 函 数 名: void CS1231_Clk(void)
* 功能说明: 时钟脉冲
* 形    参: 
      
* 返 回 值: 
*********************************************************************************************************
*/
static void CS1231_Clk(void)
{
	IO_ADC_SCLK_SET;
	delay_n_200ns(2);
	IO_ADC_SCLK_RST;
	delay_n_200ns(2);
}

/*
*********************************************************************************************************
* 设 计 者：王远，常州赛乐医疗技术有限公司
* 版	  本：V1.0
* 日    期：2021-08-27
* 函 数 名: uint8_t Read_byte_adcIC(void)
* 功能说明: 从 CS1231/CS1232 读取 1 字节的数据
* 形    参: 
      
* 返 回 值: 1 字节的无符号字符型 rdata
*********************************************************************************************************
*/
static uint8_t Read_byte_adcIC(void)
{
	uint8_t i;
	uint8_t rdata = 0; 			//	初始化返回值为 0
	for(i = 0; i < 8; i++){
		rdata <<= 1; 			//	返回值左移 1 位
		CS1231_Clk();  			//	上升沿接收数据,下降沿更新数据
		if(IO_ADC_DDAT){
			rdata += 1;  		//	若数据线上数据为 1，则返回值加 1
		}
	}
	return(rdata);
}

/*
*********************************************************************************************************
* 设 计 者：王远，常州赛乐医疗技术有限公司
* 版	  本：V1.0
* 日    期：2021-08-27
* 函 数 名: uint32_t Get_AD_adcIC(void)
* 功能说明: 从 CS1231/CS1232 读取 AD 值数据:24 位
* 形    参: 
      
* 返 回 值: 4 字节的长整型数据 gdata.word
*********************************************************************************************************
*/
static uint32_t Get_AD_adcIC(void)
{
	uint8_t i;
	union LongData gdata; 			//	联合体：一个 32 位数据及 4 字节的数组
	//用于保存从 CS1231/CS1232 读取的 AD 值
	gdata.byte[3] = 0; 				//	将 32 位数据的最高字节赋值 0 		
	if(!IO_ADC_DDAT)				//	读 AD 值之前再次确认数据线是否为低电平
	{
		IO_ADC_SCLK_RST;  			//	此语句可确保在读 AD 值之前 SCLK 为低电平
		for(i = 1; i < 4; i++) 		//	读到的 3 字节数据到在数组的元素：1~3
		{
			gdata.byte[3-i] = Read_byte_adcIC();
		}
		CS1231_Clk();  				//	向 CS1231/CS1232 发送结束标志位，即通过第25个SCLK将DRDY/DOUT拉高
		if(gdata.word > 0x00800000)	//	如果第24位不为0,说明有负电压产生，直接置零
			gdata.word = 0;
		return(gdata.word);
	}
	else
		return 0;
}

/*
*********************************************************************************************************
* 设 计 者：王远，常州赛乐医疗技术有限公司
* 版	  本：V1.0
* 日    期：2021-02-18
* 函 数 名: Get_Oil_Pressure
* 功能说明: 从 CS1231/CS1232 读取 AD 值数据:24 位液压数据
* 形    参: 
*			pdata_addr:	用于存储液压数据的地址
* 返 回 值: 
*			仅当返回 New_Data_Read_Over 表示存储在pdata_addr的数据有效
*********************************************************************************************************
*/
CS1231_State Get_Oil_Pressure(uint32_t* pdata_addr)
{
	switch(cs1231_state){
		case No_Initialized: break;
		
		case Initialized: 
			cs1231_state = If_Has_New_Data;
			break;
		
		case If_Has_New_Data:
			if(!IO_ADC_DDAT)
				cs1231_state = Wait_Read_Data;
			break;
			
		case Wait_Read_Data:
			taskENTER_CRITICAL();
			*pdata_addr = Get_AD_adcIC();
			taskEXIT_CRITICAL();
			cs1231_state = New_Data_Read_Over;
			break;
		
		case New_Data_Read_Over:
			cs1231_state = If_Has_New_Data;
			break;	
	}
	return cs1231_state;
}
